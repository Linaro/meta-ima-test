## conf/layer.conf
```bitbake
# We might have a conf and classes directory, append to BBPATH
BBPATH .= ":${LAYERDIR}"

# We have a recipes directory, add to BBFILES
BBFILES += "${LAYERDIR}/recipes*/*/*.bb ${LAYERDIR}/recipes*/*/*.bbappend"

BBFILE_COLLECTIONS += "meta-ima-test"
BBFILE_PATTERN_meta-ima-test := "^${LAYERDIR}/"
BBFILE_PRIORITY_meta-ima-test = "8"
LAYERSERIES_COMPAT_meta-ima-test = "sumo thud"

LAYERDEPENDS_meta-ima-test += "core meta-ti"
```
